## src/modules/evtol_can/Kconfig
```kconfig
menuconfig MODULES_EVTOL_CAN
	bool "evtol_can"
	default n
	---help---
		Enable support for evtol_can
```

## src/modules/evtol_canard/Kconfig
```kconfig
menuconfig MODULES_EVTOL_CANARD
	bool "evtol_canard"
	default n
	---help---
		Enable support for evtol_canard
```

## src/modules/evtol_gpio/Kconfig
```kconfig
menuconfig MODULES_EVTOL_GPIO
	bool "evtol_gpio"
	default n
	---help---
		Enable support for evtol_gpio
```

## src/modules/evtol_joystick/Kconfig
```kconfig
menuconfig MODULES_EVTOL_JOYSTICK
	bool "evtol_joystick"
	default n
	---help---
		Enable support for evtol_joystick
```

## src/modules/mc_rate_adrc/Kconfig
```kconfig
menuconfig MODULES_MC_RATE_ADRC
	bool "mc_rate_adrc"
	default n
	---help---
		Enable support for mc_rate_adrc
```
